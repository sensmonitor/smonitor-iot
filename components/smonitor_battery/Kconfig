## components/smonitor_battery/Kconfig
```kconfig
menu "SensMonitor battery"

    config SMONITOR_BATTERY_ADC_GPIO
        int "Battery ADC GPIO"
        default 35 if SMONITOR_BOARD_LILYGO_T_SIM7000G
        range 0 39
        help
            ESP32 GPIO connected to the battery voltage divider. The LilyGO
            T-SIM7000G profile uses GPIO35.

    config SMONITOR_BATTERY_DIVIDER_RATIO_MILLI
        int "Battery divider ratio x1000"
        default 2000 if SMONITOR_BOARD_LILYGO_T_SIM7000G
        range 1000 10000
        help
            Voltage divider multiplier in milli-units. Use 2000 for a 2.0x
            divider ratio.

    config SMONITOR_BATTERY_ADC_SAMPLE_COUNT
        int "Battery ADC sample count"
        default 16
        range 1 128
        help
            Number of ADC readings averaged for one battery measurement.

    config SMONITOR_BATTERY_READ_INTERVAL_SECONDS
        int "Battery read interval in seconds"
        default 300
        range 0 86400
        help
            Period for reading battery voltage. A value of 0 disables periodic
            reads and keeps the fallback value.

endmenu
```

## components/smonitor_client/Kconfig
```kconfig
menu "SensMonitor client"

    config SMONITOR_WEBSOCKET_URI
        string "SensMonitor WebSocket URI"
        default "wss://api.sensmonitor.com:9002/app/k8jv6az2crdm6nczlscm?protocol=7&client=esp32&version=1.0.0&flash=false"

    config SMONITOR_CLIENT_TIME_SYNC_RETRIES
        int "SNTP synchronization attempts"
        default 10
        range 1 60

endmenu
```

## examples/generic_esp32_sim7000/sdkconfig.defaults
```kconfig
# Generic ESP32 + UART SIM7000 board profile
CONFIG_SMONITOR_BOARD_GENERIC_ESP32_UART=y

# Modem profile
CONFIG_SMONITOR_MODEM_PROFILE_SIM7000=y

# Modem UART wiring; change these pins for the target board
CONFIG_SMONITOR_BOARD_MODEM_UART_TX_PIN=17
CONFIG_SMONITOR_BOARD_MODEM_UART_RX_PIN=16
CONFIG_SMONITOR_BOARD_MODEM_UART_RTS_PIN=-1
CONFIG_SMONITOR_BOARD_MODEM_UART_CTS_PIN=-1
CONFIG_SMONITOR_BOARD_MODEM_UART_BAUD_RATE=9600
CONFIG_SMONITOR_BOARD_MODEM_UART_RX_BUFFER_SIZE=4096
CONFIG_SMONITOR_BOARD_MODEM_UART_TX_BUFFER_SIZE=2048

# The example assumes that the modem is powered independently
CONFIG_SMONITOR_BOARD_MODEM_POWER_EXTERNAL=y

# Disable the LilyGO-specific active GPS antenna power command
# CONFIG_SMONITOR_MODEM_GPS_ENABLE_ANTENNA_POWER is not set

# I2C bus wiring; change these pins for the target board
CONFIG_SMONITOR_I2C_PORT=0
CONFIG_SMONITOR_I2C_SDA_PIN=21
CONFIG_SMONITOR_I2C_SCL_PIN=22
# CONFIG_SMONITOR_I2C_INTERNAL_PULLUPS is not set

# No generic battery voltage divider is assumed
# CONFIG_SMONITOR_BATTERY_ENABLE is not set
```

## examples/lilygo_sim7000g/sdkconfig.defaults
```kconfig
# LilyGO T-SIM7000G board profile
CONFIG_SMONITOR_BOARD_LILYGO_T_SIM7000G=y

# Modem profile
CONFIG_SMONITOR_MODEM_PROFILE_SIM7000=y

# Modem UART wiring
CONFIG_SMONITOR_BOARD_MODEM_UART_TX_PIN=27
CONFIG_SMONITOR_BOARD_MODEM_UART_RX_PIN=26
CONFIG_SMONITOR_BOARD_MODEM_UART_RTS_PIN=25
CONFIG_SMONITOR_BOARD_MODEM_UART_CTS_PIN=23
CONFIG_SMONITOR_BOARD_MODEM_PWRKEY_PIN=4
CONFIG_SMONITOR_BOARD_MODEM_UART_BAUD_RATE=9600
CONFIG_SMONITOR_BOARD_MODEM_UART_RX_BUFFER_SIZE=4096
CONFIG_SMONITOR_BOARD_MODEM_UART_TX_BUFFER_SIZE=2048

# I2C bus wiring
CONFIG_SMONITOR_I2C_PORT=0
CONFIG_SMONITOR_I2C_SDA_PIN=21
CONFIG_SMONITOR_I2C_SCL_PIN=22
CONFIG_SMONITOR_I2C_INTERNAL_PULLUPS=y

# Battery measurement wiring
CONFIG_SMONITOR_BATTERY_ADC_GPIO=35
CONFIG_SMONITOR_BATTERY_DIVIDER_RATIO_MILLI=2000
```

## examples/lilygo_sim7000g_bme280/sdkconfig.defaults
```kconfig
CONFIG_SMONITOR_BOARD_LILYGO_T_SIM7000G=y

CONFIG_SMONITOR_MODEM_APN=""
CONFIG_SMONITOR_MODEM_USERNAME=""
CONFIG_SMONITOR_MODEM_PASSWORD=""
CONFIG_SMONITOR_MODEM_AUTH_NONE=y
CONFIG_SMONITOR_MODEM_NETWORK_NB_IOT=y
CONFIG_SMONITOR_MODEM_LTE_BAND=20
CONFIG_SMONITOR_BATTERY_ADC_GPIO=35
CONFIG_SMONITOR_BATTERY_DIVIDER_RATIO_MILLI=2000
CONFIG_SMONITOR_BATTERY_ADC_SAMPLE_COUNT=16
CONFIG_SMONITOR_BATTERY_READ_INTERVAL_SECONDS=300

CONFIG_SMONITOR_I2C_FREQUENCY_HZ=100000
```

## examples/lilygo_t_sim7000g_vipmobile/sdkconfig.defaults
```kconfig
CONFIG_SMONITOR_MODEM_MODEL_SIM7000=y
CONFIG_SMONITOR_MODEM_BOARD_LILYGO_T_SIM7000G=y
CONFIG_SMONITOR_MODEM_UART_TX_PIN=27
CONFIG_SMONITOR_MODEM_UART_RX_PIN=26
CONFIG_SMONITOR_MODEM_UART_RTS_PIN=25
CONFIG_SMONITOR_MODEM_UART_CTS_PIN=23
CONFIG_SMONITOR_MODEM_PWRKEY_PIN=4

CONFIG_SMONITOR_MODEM_APN="vipmobile"
CONFIG_SMONITOR_MODEM_USERNAME="vipmobile"
CONFIG_SMONITOR_MODEM_PASSWORD="vipmobile"
CONFIG_SMONITOR_MODEM_NETWORK_AUTO=y
```

## main/Kconfig.projbuild
```kconfig
menu "SensMonitor IoT"

    choice SMONITOR_BOARD
        prompt "Hardware board"
        default SMONITOR_BOARD_LILYGO_T_SIM7000G

        config SMONITOR_BOARD_LILYGO_T_SIM7000G
            bool "LilyGO T-SIM7000G"
    endchoice

    menu "Cellular modem hardware"

        config SMONITOR_BOARD_MODEM_UART_TX_PIN
            int "Modem UART TX GPIO"
            default 27 if SMONITOR_BOARD_LILYGO_T_SIM7000G
            range 0 39

        config SMONITOR_BOARD_MODEM_UART_RX_PIN
            int "Modem UART RX GPIO"
            default 26 if SMONITOR_BOARD_LILYGO_T_SIM7000G
            range 0 39

        config SMONITOR_BOARD_MODEM_UART_RTS_PIN
            int "Modem UART RTS GPIO (-1 when unused)"
            default 25 if SMONITOR_BOARD_LILYGO_T_SIM7000G
            range -1 39

        config SMONITOR_BOARD_MODEM_UART_CTS_PIN
            int "Modem UART CTS GPIO (-1 when unused)"
            default 23 if SMONITOR_BOARD_LILYGO_T_SIM7000G
            range -1 39

        config SMONITOR_BOARD_MODEM_PWRKEY_PIN
            int "Modem PWRKEY GPIO"
            default 4 if SMONITOR_BOARD_LILYGO_T_SIM7000G
            range 0 39

        config SMONITOR_BOARD_MODEM_UART_BAUD_RATE
            int "Modem UART baud rate"
            default 9600 if SMONITOR_BOARD_LILYGO_T_SIM7000G
            range 1200 921600

        config SMONITOR_BOARD_MODEM_UART_RX_BUFFER_SIZE
            int "Modem UART RX buffer size"
            default 4096
            range 1024 16384

        config SMONITOR_BOARD_MODEM_UART_TX_BUFFER_SIZE
            int "Modem UART TX buffer size"
            default 2048
            range 512 8192

    endmenu

    config SMONITOR_MODEM_APN
        string "Mobile network APN"
        default ""
        help
            Required for a production build. It is empty by default so an
            operator profile cannot be selected accidentally.

    config SMONITOR_MODEM_USERNAME
        string "PPP authentication username"
        default ""

    config SMONITOR_MODEM_PASSWORD
        string "PPP authentication password"
        default ""

    choice SMONITOR_MODEM_AUTH
        prompt "PPP authentication"
        default SMONITOR_MODEM_AUTH_NONE

        config SMONITOR_MODEM_AUTH_NONE
            bool "None"
            help
                Matches the known-good LilyGO SIM7000G modem_console flow.

        config SMONITOR_MODEM_AUTH_PAP
            bool "PAP"
            help
                Uses the configured PPP username and password.
    endchoice

    choice SMONITOR_MODEM_NETWORK
        prompt "Preferred mobile network"
        default SMONITOR_MODEM_NETWORK_NB_IOT

        config SMONITOR_MODEM_NETWORK_AUTO
            bool "Automatic"
        config SMONITOR_MODEM_NETWORK_LTE_M
            bool "LTE-M"
        config SMONITOR_MODEM_NETWORK_NB_IOT
            bool "NB-IoT"
        config SMONITOR_MODEM_NETWORK_GPRS
            bool "GPRS"
    endchoice

    config SMONITOR_SAMPLE_INTERVAL_MS
        int "Sample interval in milliseconds"
        default 5000
        range 1000 3600000

    config SMONITOR_MODEM_CONNECT_TIMEOUT_MS
        int "PPP connection timeout in milliseconds"
        default 180000
        range 10000 600000

    menu "I2C bus"

        config SMONITOR_I2C_PORT
            int "I2C controller"
            default 0 if SMONITOR_BOARD_LILYGO_T_SIM7000G
            range 0 1

        config SMONITOR_I2C_SDA_PIN
            int "I2C SDA GPIO"
            default 21 if SMONITOR_BOARD_LILYGO_T_SIM7000G
            range 0 39

        config SMONITOR_I2C_SCL_PIN
            int "I2C SCL GPIO"
            default 22 if SMONITOR_BOARD_LILYGO_T_SIM7000G
            range 0 39

        config SMONITOR_I2C_FREQUENCY_HZ
            int "I2C bus frequency"
            default 100000
            range 10000 1000000

        config SMONITOR_I2C_INTERNAL_PULLUPS
            bool "Enable ESP32 internal pull-ups"
            default y if SMONITOR_BOARD_LILYGO_T_SIM7000G
            help
                Internal pull-ups are useful during development but external
                pull-up resistors are recommended for reliable hardware.

    endmenu

endmenu
```

## sdkconfig.defaults
```kconfig
CONFIG_IDF_TARGET="esp32"
CONFIG_ESP_MAIN_TASK_STACK_SIZE=7168
CONFIG_LWIP_PPP_SUPPORT=y
CONFIG_LWIP_PPP_NOTIFY_PHASE_SUPPORT=y
CONFIG_LWIP_PPP_PAP_SUPPORT=y
CONFIG_LWIP_TCPIP_TASK_STACK_SIZE=4096
# CONFIG_LWIP_PPP_ENABLE_IPV6 is not set

CONFIG_SMONITOR_MODEM_MODEL_SIM7000=y
CONFIG_SMONITOR_MODEM_BOARD_LILYGO_T_SIM7000G=y
CONFIG_SMONITOR_MODEM_UART_TX_PIN=27
CONFIG_SMONITOR_MODEM_UART_RX_PIN=26
CONFIG_SMONITOR_MODEM_UART_RTS_PIN=25
CONFIG_SMONITOR_MODEM_UART_CTS_PIN=23
CONFIG_SMONITOR_MODEM_PWRKEY_PIN=4

CONFIG_SMONITOR_MODEM_APN=""
CONFIG_SMONITOR_MODEM_USERNAME=""
CONFIG_SMONITOR_MODEM_PASSWORD=""
CONFIG_SMONITOR_MODEM_AUTH_NONE=y
CONFIG_SMONITOR_MODEM_NETWORK_NB_IOT=y
CONFIG_SMONITOR_MODEM_LTE_BAND=20
CONFIG_SMONITOR_DEVICE_TOKEN=""
CONFIG_SMONITOR_SAMPLE_INTERVAL_MS=5000
CONFIG_SMONITOR_BATTERY_ADC_GPIO=35
CONFIG_SMONITOR_BATTERY_DIVIDER_RATIO_MILLI=2000
CONFIG_SMONITOR_BATTERY_ADC_SAMPLE_COUNT=16
CONFIG_SMONITOR_BATTERY_READ_INTERVAL_SECONDS=300
CONFIG_SMONITOR_MODEM_CONNECT_TIMEOUT_MS=180000

CONFIG_SMONITOR_I2C_SENSOR_BME280=y
CONFIG_SMONITOR_I2C_PORT=0
CONFIG_SMONITOR_I2C_SDA_PIN=21
CONFIG_SMONITOR_I2C_SCL_PIN=22
CONFIG_SMONITOR_I2C_FREQUENCY_HZ=100000
CONFIG_SMONITOR_I2C_INTERNAL_PULLUPS=y
CONFIG_SMONITOR_I2C_DEVICE_ADDRESS=0x76
```

## sdkconfig.defaults.local.example
```kconfig
# Copy this file to sdkconfig.defaults.local and fill in local values.
# sdkconfig.defaults.local is ignored by Git.

CONFIG_SMONITOR_MODEM_APN=""

# Select board
CONFIG_SMONITOR_BOARD_LILYGO_T_SIM7000G=y

# Select I2C sensor
CONFIG_SMONITOR_I2C_SENSOR_BME280=y

# Mobile network technology
CONFIG_SMONITOR_MODEM_NETWORK_NB_IOT=y
# CONFIG_SMONITOR_MODEM_NETWORK_LTE_M=y
# CONFIG_SMONITOR_MODEM_NETWORK_GPRS=y
# CONFIG_SMONITOR_MODEM_NETWORK_AUTO=y

# LPWA band used by NB-IoT/LTE-M
CONFIG_SMONITOR_MODEM_LPWA_BAND=20

# LPWA mode:
# CONFIG_SMONITOR_MODEM_LPWA_MODE_PSM_ENABLE=y
# CONFIG_SMONITOR_MODEM_LPWA_MODE_EDRX_ENABLE=y
```
